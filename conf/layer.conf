## conf/layer.conf
```bitbake
# We have a conf and classes directory, add to BBPATH
BBPATH .= ":${LAYERDIR}"

# We have a recipes-* directories, add to BBFILES
BBFILES += "${LAYERDIR}/recipes-*/*/*.bb \
            ${LAYERDIR}/recipes-*/*/*.bbappend"

BBFILE_COLLECTIONS += "kontron_come_xtl6"
BBFILE_PATTERN_kontron_come_xtl6 := "^${LAYERDIR}/"
BBFILE_PRIORITY_kontron_come_xtl6 = "10"

#LAYERDEPENDS_kontron_come_xtl6 = "intel"

# Additional license directories.
LICENSE_PATH += "${LAYERDIR}/custom-licenses"

# This should only be incremented on significant changes that will
# cause compatibility issues with other layers
LAYERVERSION_kontron_come_xtl6 = "5"
LAYERSERIES_COMPAT_kontron_come_xtl6 = "honister"
```

## conf/machine/kontron-come-xtl6-64.conf
```bitbake
#@TYPE: Machine
#@NAME: kontron-come-xtl6

#@DESCRIPTION: Machine configuration for Kontron COMe-xTL6 (xtl6) 64 bit

PREFERRED_PROVIDER_virtual/kernel ?= "linux-kontron-come-xtl6"
# Alternatively a realtime kernel can be built
#PREFERRED_PROVIDER_virtual/kernel = "linux-kontron-come-xtl6-rt"
PREFERRED_VERSION_linux-kontron-come-xtl6 ?= "5.10%"

DEFAULTTUNE ?= "corei7-64"
require conf/machine/include/intel-corei7-64-common.inc
require conf/machine/include/meta-intel.inc
require conf/machine/include/intel-common-pkgarch.inc

MACHINE_FEATURES += "pcbios efi"
MACHINE_FEATURES += "va-impl-intel"
MACHINE_FEATURES += "intel-ucode amd-ucode"
MACHINE_FEATURES += "usbgadget"
MACHINE_FEATURES += "usbhost"
MACHINE_FEATURES += "pci"
MACHINE_FEATURES += "alsa"
MACHINE_FEATURES += "tpm2"
MACHINE_FEATURES += "x86-64 x86"
MACHINE_FEATURES += "wifi"

MACHINE_HWCODECS += " intel-vaapi-driver gstreamer1.0-vaapi"
MACHINE_HWCODECS += " intel-media-driver intel-mediasdk"

XSERVER = "${XSERVER_X86_BASE} \
            ${XSERVER_X86_EXT} \
            ${XSERVER_X86_I915} \
            ${XSERVER_X86_I965} \
            ${XSERVER_X86_FBDEV} \
            ${XSERVER_X86_MODESETTING} \
            ${XSERVER_X86_VESA} \
            xf86-video-ati \
            xf86-video-amdgpu \
            xf86-video-nouveau \
           "

# Uncomment for Multilib support
#require conf/multilib.conf
#MULTILIBS = "multilib:lib32"
#DEFAULTTUNE_virtclass-multilib-lib32 = "x86"

# i915 firmware is needed for Intel graphics driver, igb, 1000e and r8152
# for the case the image should be started from network
PACKAGE_INSTALL:append:pn-core-image-minimal-initramfs = " \
            linux-firmware-i915 \
            kernel-module-igb \
            kernel-module-e1000e \
            kernel-module-r8152 \
            "

PREFERRED_PROVIDER_virtual/keapi-config = "keapi-config-come"
# libkeapi3 libraries and tools
MACHINE_EXTRA_RRECOMMENDS += "libkeapi3"

MACHINE_EXTRA_RDEPENDS += "linux-firmware"
MACHINE_EXTRA_RDEPENDS += "eudev-hwdb"
MACHINE_EXTRA_RRECOMMENDS += "linuxptp grub-efi"
MACHINE_EXTRA_RRECOMMENDS += "efibootmgr"

# Enable kernel messages on ttyS0, ttyS4 and tty0
SERIAL_CONSOLES = "115200;ttyS4 115200;ttyS0"
SERIAL_CONSOLES_CHECK = "ttyS4 ttyS0"
APPEND += "console=ttyS4,115200 console=ttyS0,115200 console=tty0"
SYSLINUX_OPTS = "serial 0 115200"

# Only show errors during boot
APPEND += "quiet"

KERNEL_MODULE_PROBECONF += "gpio-kempld i2c-kempld snd-hda-intel"
module_conf_gpio-kempld = "options gpio-kempld gpiobase=0 restore_state=1"
module_conf_i2c-kempld = "options i2c-kempld i2c_bus=100"
module_conf_snd-hda-intel = "options snd-hda-intel index=1,0"

PREFERRED_PROVIDER_cryptsetup ?= "cryptsetup-tpm-incubator"
PREFERRED_RPROVIDER_whiptail ?= "libnewt"

# Disabling power management can help to reduce latency for RT kernels
# Available options in the EFI setup CPU configuration should be also disabled.
#APPEND += "intel_idle.max_cstate=0 processor.max_cstate=0 intel_pstate=disable"

# Allow overriding values using optional *-64-extra.conf
include conf/machine/${MACHINE}-extra.conf

DISTRO_FEATURES:append = " security tpm tpm2"
```
